## boards/shields/cosmotyl/Kconfig.shield
```kconfig
config SHIELD_COSMOTYL_XIAO_LEFT
    def_bool $(shields_list_contains,cosmotyl_xiao_left)

config SHIELD_COSMOTYL_XIAO_RIGHT
    def_bool $(shields_list_contains,cosmotyl_xiao_right)
```
